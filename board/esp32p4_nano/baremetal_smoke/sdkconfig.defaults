## board/esp32p4_nano/baremetal_smoke/sdkconfig.defaults
```kconfig
CONFIG_ESP32P4_SELECTS_REV_LESS_V3=y
CONFIG_ESP32P4_REV_MIN_100=y
CONFIG_BOOTLOADER_WDT_ENABLE=n
CONFIG_BOOTLOADER_LOG_LEVEL_INFO=y
CONFIG_COMPILER_CXX_EXCEPTIONS=n
CONFIG_COMPILER_CXX_RTTI=n
CONFIG_ESPTOOLPY_FLASHSIZE_16MB=y
CONFIG_FREERTOS_UNICORE=y
```
